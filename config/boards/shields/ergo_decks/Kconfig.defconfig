## config/boards/shields/ergo_decks/Kconfig.defconfig
```kconfig
if SHIELD_ERGO_DECKS_LEFT

# Name must be less than 16 characters long!
config ZMK_KEYBOARD_NAME
    default "ErgoDecks"

config ZMK_SPLIT_ROLE_CENTRAL
    default y

endif

if SHIELD_ERGO_DECKS_LEFT || SHIELD_ERGO_DECKS_RIGHT

config ZMK_SPLIT
    default y

endif
```

## config/boards/shields/ergo_decks/Kconfig.shield
```kconfig
# No whitespace after the comma or in your part name!
config SHIELD_ERGO_DECKS_LEFT
    def_bool $(shields_list_contains,ergo_decks_left)

# No whitespace after the comma or in your part name!
config SHIELD_ERGO_DECKS_RIGHT
    def_bool $(shields_list_contains,ergo_decks_right)
```
